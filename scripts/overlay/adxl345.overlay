#include <zephyr/dt-bindings/gpio/gpio.h>
#include <zephyr/dt-bindings/sensor/adxl345.h>

/ {
        aliases {
                accel0 = &adxl;
        };
};

&i2c1 {
        adxl: adxl@53 {
                compatible = "adi,adxl345";
                reg = <0x53>;
                odr = <ADXL345_DT_ODR_12_5>;
                int1-gpios = <&gpiod 15 GPIO_ACTIVE_HIGH>;
        };
};
